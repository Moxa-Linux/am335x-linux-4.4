## drivers/crypto/hw_api/Kconfig
```kconfig
config CRYPTO_DEV_LINUX
	tristate "Userspace API for accessing HW accelerators"
	default "m"
	help
	  Cryptodev-linux is a Linux-kernel device that allows user-space access to hardware c		ryptographic accelerators. 
```

## its/am335x-moxa-uc-2100.its
```
/*
 * U-Boot itb image source file for "uc2100 project"
 */

/dts-v1/;

/ {
	description = "U-Boot itb image source file for uc2100 project";
	#address-cells = <1>;
	
	images {
		kernel@uc2100 {
			description = "Moxa UC2100 Series Unify Linux Kernel";
			data = /incbin/("../arch/arm/boot/zImage");
			type = "kernel";
			arch = "arm";
			os = "linux";
			compression = "none";
			load = <0x80080000>;
			entry = <0x80080000>;
		};
		fdt@uc2101 {
			description = "Flattened Device Tree blob for UC2101";
			data = /incbin/("../arch/arm/boot/dts/am335x-moxa-uc-2101.dtb");
			type = "flat_dt";
			arch = "arm";
			compression = "none";
			load = <0x80000000>;
		};
		fdt@uc2102 {
			description = "Flattened Device Tree blob for UC2102";
			data = /incbin/("../arch/arm/boot/dts/am335x-moxa-uc-2102.dtb");
			type = "flat_dt";
			arch = "arm";
			compression = "none";
			load = <0x80000000>;
		};
		fdt@uc2104 {
			description = "Flattened Device Tree blob for UC2104";
			data = /incbin/("../arch/arm/boot/dts/am335x-moxa-uc-2104.dtb");
			type = "flat_dt";
			arch = "arm";
			compression = "none";
			load = <0x80000000>;
		};
		fdt@uc2111 {
			description = "Flattened Device Tree blob for UC2111";
			data = /incbin/("../arch/arm/boot/dts/am335x-moxa-uc-2111.dtb");
			type = "flat_dt";
			arch = "arm";
			compression = "none";
			load = <0x80000000>;
		};
		fdt@uc2112 {
			description = "Flattened Device Tree blob for UC2112";
			data = /incbin/("../arch/arm/boot/dts/am335x-moxa-uc-2112.dtb");
			type = "flat_dt";
			arch = "arm";
			compression = "none";
			load = <0x80000000>;
		};
		fdt@uc2114 {
			description = "Flattened Device Tree blob for UC2114";
			data = /incbin/("../arch/arm/boot/dts/am335x-moxa-uc-2114.dtb");
			type = "flat_dt";
			arch = "arm";
			compression = "none";
			load = <0x80000000>;
		};
		fdt@uc2116 {
			description = "Flattened Device Tree blob for UC2116";
			data = /incbin/("../arch/arm/boot/dts/am335x-moxa-uc-2116.dtb");
			type = "flat_dt";
			arch = "arm";
			compression = "none";
			load = <0x80000000>;
		};
	};
	
	configurations {
		default = "uc2101";
		uc2101 {
			description = "Boot Linux kernel with uc2101 FDT blob";
			kernel = "kernel@uc2100";
			fdt = "fdt@uc2101";
		};
		uc2102 {
			description = "Boot Linux kernel with uc2102 FDT blob";
			kernel = "kernel@uc2100";
			fdt = "fdt@uc2102";
		};
		uc2104 {
			description = "Boot Linux kernel with uc2104 FDT blob";
			kernel = "kernel@uc2100";
			fdt = "fdt@uc2104";
		};
		uc2111 {
			description = "Boot Linux kernel with uc2111 FDT blob";
			kernel = "kernel@uc2100";
			fdt = "fdt@uc2111";
		};
		uc2112 {
			description = "Boot Linux kernel with uc2112 FDT blob";
			kernel = "kernel@uc2100";
			fdt = "fdt@uc2112";
		};
		uc2114 {
			description = "Boot Linux kernel with uc2114 FDT blob";
			kernel = "kernel@uc2100";
			fdt = "fdt@uc2114";
		};
		uc2116 {
			description = "Boot Linux kernel with uc2116 FDT blob";
			kernel = "kernel@uc2100";
			fdt = "fdt@uc2116";
		};
	};
};
```

## its/am335x-moxa-uc-3100.its
```
/*
 * U-Boot itb image source file for "uc3100 project"
 */

/dts-v1/;

/ {
	description = "U-Boot itb image source file for uc3100 project";
	#address-cells = <1>;
	
	images {
		kernel@uc3100 {
			description = "Moxa UC3100 Series Unify Linux Kernel";
			data = /incbin/("../arch/arm/boot/zImage");
			type = "kernel";
			arch = "arm";
			os = "linux";
			compression = "none";
			load = <0x80080000>;
			entry = <0x80080000>;
		};
		fdt@uc3101 {
			description = "Flattened Device Tree blob for UC3101";
			data = /incbin/("../arch/arm/boot/dts/am335x-moxa-uc-3101.dtb");
			type = "flat_dt";
			arch = "arm";
			compression = "none";
			load = <0x80000000>;
		};
		fdt@uc3111 {
			description = "Flattened Device Tree blob for UC3111";
			data = /incbin/("../arch/arm/boot/dts/am335x-moxa-uc-3111.dtb");
			type = "flat_dt";
			arch = "arm";
			compression = "none";
			load = <0x80000000>;
		};
		fdt@uc3121 {
			description = "Flattened Device Tree blob for UC3121";
			data = /incbin/("../arch/arm/boot/dts/am335x-moxa-uc-3121.dtb");
			type = "flat_dt";
			arch = "arm";
			compression = "none";
			load = <0x80000000>;
		};
	};
	
	configurations {
		default = "uc3101";
		uc3101 {
			description = "Boot Linux kernel with uc3101 FDT blob";
			kernel = "kernel@uc3100";
			fdt = "fdt@uc3101";
		};
		uc3111 {
			description = "Boot Linux kernel with uc3111 FDT blob";
			kernel = "kernel@uc3100";
			fdt = "fdt@uc3111";
		};
		uc3121 {
			description = "Boot Linux kernel with uc3121 FDT blob";
			kernel = "kernel@uc3100";
			fdt = "fdt@uc3121";
		};
	};
};
```

## its/am335x-moxa-uc-5100.its
```
/*
 * U-Boot itb image source file for "uc5100 project"
 */

/dts-v1/;

/ {
	description = "U-Boot itb image source file for uc5100 project";
	#address-cells = <1>;
	
	images {
		kernel@uc5100 {
			description = "Moxa UC5100 Series Unify Linux Kernel";
			data = /incbin/("../arch/arm/boot/zImage");
			type = "kernel";
			arch = "arm";
			os = "linux";
			compression = "none";
			load = <0x80080000>;
			entry = <0x80080000>;
		};
		fdt@uc5101 {
			description = "Flattened Device Tree blob for UC5101";
			data = /incbin/("../arch/arm/boot/dts/am335x-moxa-uc-5101.dtb");
			type = "flat_dt";
			arch = "arm";
			compression = "none";
			load = <0x80000000>;
		};
		fdt@uc5102 {
			description = "Flattened Device Tree blob for UC5102";
			data = /incbin/("../arch/arm/boot/dts/am335x-moxa-uc-5102.dtb");
			type = "flat_dt";
			arch = "arm";
			compression = "none";
			load = <0x80000000>;
		};
		fdt@uc5111 {
			description = "Flattened Device Tree blob for UC5111";
			data = /incbin/("../arch/arm/boot/dts/am335x-moxa-uc-5111.dtb");
			type = "flat_dt";
			arch = "arm";
			compression = "none";
			load = <0x80000000>;
		};
		fdt@uc5112 {
			description = "Flattened Device Tree blob for UC5112";
			data = /incbin/("../arch/arm/boot/dts/am335x-moxa-uc-5112.dtb");
			type = "flat_dt";
			arch = "arm";
			compression = "none";
			load = <0x80000000>;
		};
	};
	
	configurations {
		default = "uc5101";
		uc5101 {
			description = "Boot Linux kernel with uc5101 FDT blob";
			kernel = "kernel@uc5100";
			fdt = "fdt@uc5101";
		};
		uc5102 {
			description = "Boot Linux kernel with uc5102 FDT blob";
			kernel = "kernel@uc5100";
			fdt = "fdt@uc5102";
		};
		uc5111 {
			description = "Boot Linux kernel with uc5111 FDT blob";
			kernel = "kernel@uc5100";
			fdt = "fdt@uc5111";
		};
		uc5112 {
			description = "Boot Linux kernel with uc5112 FDT blob";
			kernel = "kernel@uc5100";
			fdt = "fdt@uc5112";
		};
	};
};
```

## its/am335x-moxa-uc-8100a-me.its
```
/*
 * U-Boot itb image source file for "uc8100a-me project"
 */

/dts-v1/;

/ {
	description = "U-Boot itb image source file for uc8100a-me project";
	#address-cells = <1>;

	images {
		kernel@uc8100a-me {
			description = "Moxa UC8100A-ME Series Unify Linux Kernel";
			data = /incbin/("../arch/arm/boot/zImage");
			type = "kernel";
			arch = "arm";
			os = "linux";
			compression = "none";
			load = <0x80080000>;
			entry = <0x80080000>;
		};
		fdt@uc8100a-me {
			description = "Flattened Device Tree blob for UC8100A-ME";
			data = /incbin/("../arch/arm/boot/dts/am335x-moxa-uc-8100a-me.dtb");
			type = "flat_dt";
			arch = "arm";
			compression = "none";
			load = <0x80000000>;
		};
	};

	configurations {
		default = "uc8100a-me";
		uc8100a-me {
			description = "Boot Linux kernel with uc8100a-me FDT blob";
			kernel = "kernel@uc8100a-me";
			fdt = "fdt@uc8100a-me";
		};
	};
};
```

## mm/Kconfig.debug
```kconfig
config PAGE_EXTENSION
	bool "Extend memmap on extra space for more information on page"
	---help---
	  Extend memmap on extra space for more information on page. This
	  could be used for debugging features that need to insert extra
	  field for every page. This extension enables us to save memory
	  by not allocating this extra memory according to boottime
	  configuration.

config DEBUG_PAGEALLOC
	bool "Debug page memory allocations"
	depends on DEBUG_KERNEL
	depends on !HIBERNATION || ARCH_SUPPORTS_DEBUG_PAGEALLOC && !PPC && !SPARC
	depends on !KMEMCHECK
	select PAGE_EXTENSION
	select PAGE_POISONING if !ARCH_SUPPORTS_DEBUG_PAGEALLOC
	---help---
	  Unmap pages from the kernel linear mapping after free_pages().
	  This results in a large slowdown, but helps to find certain types
	  of memory corruption.

	  For architectures which don't enable ARCH_SUPPORTS_DEBUG_PAGEALLOC,
	  fill the pages with poison patterns after free_pages() and verify
	  the patterns before alloc_pages().  Additionally,
	  this option cannot be enabled in combination with hibernation as
	  that would result in incorrect warnings of memory corruption after
	  a resume because free pages are not saved to the suspend image.

config PAGE_POISONING
	bool "Poison pages after freeing"
	select PAGE_EXTENSION
	select PAGE_POISONING_NO_SANITY if HIBERNATION
	---help---
	  Fill the pages with poison patterns after free_pages() and verify
	  the patterns before alloc_pages. The filling of the memory helps
	  reduce the risk of information leaks from freed data. This does
	  have a potential performance impact.

	  Note that "poison" here is not the same thing as the "HWPoison"
	  for CONFIG_MEMORY_FAILURE. This is software poisoning only.

	  If unsure, say N

config PAGE_POISONING_NO_SANITY
	depends on PAGE_POISONING
	bool "Only poison, don't sanity check"
	---help---
	   Skip the sanity checking on alloc, only fill the pages with
	   poison on free. This reduces some of the overhead of the
	   poisoning feature.

	   If you are only interested in sanitization, say Y. Otherwise
	   say N.
```
